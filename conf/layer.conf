## conf/layer.conf
```bitbake
# Add layer to BBPATH
BBPATH .= ":${LAYERDIR}"

# Recipe and bbappend search paths
BBFILES += "${LAYERDIR}/recipes-*/*/*.bb \
            ${LAYERDIR}/recipes-*/*/*.bbappend"

# Layer collection
BBFILE_COLLECTIONS += "mtk-ucom"

BBFILE_PATTERN_mtk-ucom = "^${LAYERDIR}/"
BBFILE_PRIORITY_mtk-ucom = "12"

# Layer version
LAYERVERSION_mtk-ucom = "1"

# Layer dependencies
LAYERDEPENDS_mtk-ucom = "core mediatek-bsp"

# Yocto release compatibility
LAYERSERIES_COMPAT_mtk-ucom = "scarthgap"
```

## conf/machine/include/aaeon-software.inc
```bitbake
# ============================================================
# AAEON UCOM Common Software
# ============================================================

IMAGE_INSTALL:append = " packagegroup-core-aaeon"
```

## conf/machine/mtk-ucom-m510.conf
```bitbake
# UCOM M510 - MediaTek MT8370
# Based on Genio 510 EVK

require conf/machine/mt8370-evk.conf

# OP-TEE - 8GB DRAM
OPTEE_DRAM_SIZE:mtk-ucom-m510 = "0x200000000"

# Kernel - customize later
KERNEL_DEVICETREE = "mediatek/mt8370-genio-510-evk-ucom-m510.dtb"

# Custom Display DTBO
KERNEL_DEVICETREE_OVERLAYS_AUTOLOAD:remove = " \
    display-dsi.dtbo \
"
```

## conf/machine/mtk-ucom-m700.conf
```bitbake
# UCOM M700 - MediaTek MT8390
# Based on Genio 700 EVK

require conf/machine/mt8390-evk.conf
require conf/machine/include/aaeon-software.inc

# Kernel - customize later
KERNEL_DEVICETREE = "mediatek/mt8390-genio-700-evk-ucom-m700.dtb"

# Custom Display DTBO
KERNEL_DEVICETREE_OVERLAYS_AUTOLOAD:remove = " \
    display-dsi.dtbo \
"
```
